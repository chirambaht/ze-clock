## app/boards/xtensa/esp32_lolin_oled/Kconfig.board
```kconfig
# Copyright (c) 2023 Espressif Systems (Shanghai) Co., Ltd.
# SPDX-License-Identifier: Apache-2.0

config BOARD_ESP32_LOLIN_OLED
	bool "ESP32-LOLIN_OLED Development Board"
	depends on SOC_ESP32
```
